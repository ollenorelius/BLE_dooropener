## build_nrf52810_pca10040/Kconfig.modules
```kconfig
osource "C:/Users/Olle/Documents/ncs/ncs/nrf/Kconfig.nrf"

osource "C:/Users/Olle/Documents/ncs/ncs/mcuboot/zephyr/Kconfig"

osource "C:/Users/Olle/Documents/ncs/ncs/nrfxlib/Kconfig.nrfxlib"
```
